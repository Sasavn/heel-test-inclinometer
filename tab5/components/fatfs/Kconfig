## tab5/components/fatfs/Kconfig
```kconfig
source "$IDF_PATH/components/fatfs/Kconfig"

menu "Tab5 extended filesystem support"
config FATFS_EXFAT
    bool "Enable exFAT in the pinned FatFS component"
    default y
    depends on !FATFS_LFN_NONE
    help
        Project-generated ffconf.h enables the upstream exFAT implementation.
        All FatFS/VFS/MSC/application consumers share this same header ABI.
        Existing media is never formatted or converted by this option.
endmenu
```

## tab5/components/tab5_input/Kconfig
```kconfig
menu "Tab5 physical inputs"
config TAB5_INPUT_GPIO_ENABLE
    bool "Enable explicitly configured physical inputs"
    default n
    help
        Does not start automatically. Verify mainboard revision, connector
        orientation and attached modules before calling start.
endmenu
```

## tab5/main/Kconfig.projbuild
```kconfig
menu "Tab5 native UI diagnostics"

config TAB5_NATIVE_FINE_PROFILE
    bool "Count individual UI primitives and cache operations"
    default n
    help
        Diagnostic builds only. Enables per-primitive/pixel and style/layout
        cache counters. Coarse frame, update, render and memory accounting
        remain available with this disabled. Release builds leave it off.

config TAB5_NATIVE_PRIMITIVE_TIMING
    bool "Time individual UI primitives"
    default n
    select TAB5_NATIVE_FINE_PROFILE
    help
        Diagnostic builds only. Reads the microsecond clock around every
        primitive. This changes rendering cost; use a separate diagnostic
        run, never silently mix it into a coarse performance comparison.

endmenu
```

## tab5/sdkconfig.defaults
```kconfig
CONFIG_IDF_TARGET="esp32p4"
CONFIG_ESPTOOLPY_FLASHSIZE_16MB=y
CONFIG_PARTITION_TABLE_CUSTOM=y
CONFIG_PARTITION_TABLE_CUSTOM_FILENAME="partitions.csv"
CONFIG_BOOTLOADER_APP_ROLLBACK_ENABLE=y
CONFIG_ESP32P4_SELECTS_REV_LESS_V3=y
CONFIG_ESP32P4_REV_MIN_100=y
CONFIG_SPIRAM=y
CONFIG_SPIRAM_SPEED_200M=y
CONFIG_ESP_HOSTED_MEMPOOL_PREFER_SPIRAM=y
CONFIG_COMPILER_OPTIMIZATION_PERF=y
CONFIG_FREERTOS_GENERATE_RUN_TIME_STATS=y
CONFIG_FREERTOS_RUN_TIME_STATS_USING_ESP_TIMER=y
CONFIG_IDF_EXPERIMENTAL_FEATURES=y
CONFIG_FREERTOS_HZ=1000
CONFIG_ESP_MAIN_TASK_STACK_SIZE=12288
CONFIG_ESP_CONSOLE_USB_SERIAL_JTAG=y
CONFIG_LOG_DEFAULT_LEVEL_INFO=y
CONFIG_BSP_ERROR_CHECK=n
CONFIG_BSP_SD_FORMAT_ON_MOUNT_FAIL=n
CONFIG_FATFS_LFN_HEAP=y
CONFIG_FATFS_MAX_LFN=128
CONFIG_FATFS_FS_LOCK=12
CONFIG_FATFS_TIMEOUT_MS=1000
CONFIG_ESP_HOSTED_CP_TARGET_ESP32C6=y
CONFIG_SLAVE_IDF_TARGET_ESP32C6=y
CONFIG_ESP32P4_TAB5_C6_BOARD=y
CONFIG_ESP_HOSTED_SDIO_HOST_INTERFACE=y
CONFIG_ESP_HOSTED_SDIO_RESET_ACTIVE_HIGH=y
CONFIG_UART_ISR_IN_IRAM=y
```
